# file: BSMU_H750IB.ioc
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CORTEX_M7.AccessPermission-Cortex_Memory_Protection_Unit_Region1_Settings=MPU_REGION_FULL_ACCESS
CORTEX_M7.AccessPermission-Cortex_Memory_Protection_Unit_Region2_Settings=MPU_REGION_FULL_ACCESS
CORTEX_M7.AccessPermission-Cortex_Memory_Protection_Unit_Region3_Settings=MPU_REGION_FULL_ACCESS
CORTEX_M7.AccessPermission-Cortex_Memory_Protection_Unit_Region4_Settings=MPU_REGION_FULL_ACCESS
CORTEX_M7.AccessPermission-Cortex_Memory_Protection_Unit_Region5_Settings=MPU_REGION_FULL_ACCESS
CORTEX_M7.AccessPermission_S-Cortex_Memory_Protection_Unit_Region1_Settings_S=MPU_REGION_FULL_ACCESS
CORTEX_M7.AccessPermission_Spec=MPU_REGION_FULL_ACCESS
CORTEX_M7.BaseAddress-Cortex_Memory_Protection_Unit_Region1_Settings=0x30040000
CORTEX_M7.BaseAddress-Cortex_Memory_Protection_Unit_Region2_Settings=0x30040000
CORTEX_M7.BaseAddress-Cortex_Memory_Protection_Unit_Region3_Settings=0x30020000
CORTEX_M7.BaseAddress-Cortex_Memory_Protection_Unit_Region4_Settings=0xC0000000
CORTEX_M7.BaseAddress-Cortex_Memory_Protection_Unit_Region5_Settings=0x30000000
CORTEX_M7.BaseAddress_S-Cortex_Memory_Protection_Unit_Region1_Settings_S=0x30040000
CORTEX_M7.BaseAddress_Spec=0x30040000
CORTEX_M7.CPU_DCache=Enabled
CORTEX_M7.CPU_ICache=Enabled
CORTEX_M7.DisableExec-Cortex_Memory_Protection_Unit_Region1_Settings=MPU_INSTRUCTION_ACCESS_DISABLE
CORTEX_M7.DisableExec-Cortex_Memory_Protection_Unit_Region2_Settings=MPU_INSTRUCTION_ACCESS_DISABLE
CORTEX_M7.DisableExec-Cortex_Memory_Protection_Unit_Region3_Settings=MPU_INSTRUCTION_ACCESS_DISABLE
CORTEX_M7.DisableExec-Cortex_Memory_Protection_Unit_Region4_Settings=MPU_INSTRUCTION_ACCESS_DISABLE
CORTEX_M7.DisableExec-Cortex_Memory_Protection_Unit_Region5_Settings=MPU_INSTRUCTION_ACCESS_DISABLE
CORTEX_M7.DisableExec_S-Cortex_Memory_Protection_Unit_Region1_Settings_S=MPU_INSTRUCTION_ACCESS_DISABLE
CORTEX_M7.Enable-Cortex_Memory_Protection_Unit_Region0_Settings=__NULL
CORTEX_M7.Enable-Cortex_Memory_Protection_Unit_Region1_Settings=MPU_REGION_ENABLE
CORTEX_M7.Enable-Cortex_Memory_Protection_Unit_Region2_Settings=MPU_REGION_ENABLE
CORTEX_M7.Enable-Cortex_Memory_Protection_Unit_Region3_Settings=MPU_REGION_ENABLE
CORTEX_M7.Enable-Cortex_Memory_Protection_Unit_Region4_Settings=MPU_REGION_ENABLE
CORTEX_M7.Enable-Cortex_Memory_Protection_Unit_Region5_Settings=MPU_REGION_ENABLE
CORTEX_M7.Enable_S-Cortex_Memory_Protection_Unit_Region1_Settings_S=MPU_REGION_ENABLE
CORTEX_M7.IsBufferable-Cortex_Memory_Protection_Unit_Region1_Settings=MPU_ACCESS_NOT_BUFFERABLE
CORTEX_M7.IsBufferable-Cortex_Memory_Protection_Unit_Region2_Settings=MPU_ACCESS_BUFFERABLE
CORTEX_M7.IsBufferable-Cortex_Memory_Protection_Unit_Region5_Settings=MPU_ACCESS_NOT_BUFFERABLE
CORTEX_M7.IsBufferable_S-Cortex_Memory_Protection_Unit_Region1_Settings_S=MPU_ACCESS_BUFFERABLE
CORTEX_M7.IsCacheable-Cortex_Memory_Protection_Unit_Region1_Settings=MPU_ACCESS_NOT_CACHEABLE
CORTEX_M7.IsCacheable-Cortex_Memory_Protection_Unit_Region5_Settings=MPU_ACCESS_NOT_CACHEABLE
CORTEX_M7.IsShareable-Cortex_Memory_Protection_Unit_Region1_Settings=MPU_ACCESS_NOT_SHAREABLE
CORTEX_M7.IsShareable-Cortex_Memory_Protection_Unit_Region2_Settings=MPU_ACCESS_SHAREABLE
CORTEX_M7.IsShareable-Cortex_Memory_Protection_Unit_Region5_Settings=MPU_ACCESS_SHAREABLE
CORTEX_M7.IsShareable_S-Cortex_Memory_Protection_Unit_Region1_Settings_S=MPU_ACCESS_SHAREABLE
CORTEX_M7.IsShareable_Spec=MPU_ACCESS_NOT_SHAREABLE
CORTEX_M7.MPU_Control=MPU_PRIVILEGED_DEFAULT
CORTEX_M7.Size-Cortex_Memory_Protection_Unit_Region1_Settings=MPU_REGION_SIZE_32KB
CORTEX_M7.Size-Cortex_Memory_Protection_Unit_Region2_Settings=MPU_REGION_SIZE_256B
CORTEX_M7.Size-Cortex_Memory_Protection_Unit_Region3_Settings=MPU_REGION_SIZE_32KB
CORTEX_M7.Size-Cortex_Memory_Protection_Unit_Region4_Settings=MPU_REGION_SIZE_4MB
CORTEX_M7.Size-Cortex_Memory_Protection_Unit_Region5_Settings=MPU_REGION_SIZE_16KB
CORTEX_M7.Size_S-Cortex_Memory_Protection_Unit_Region1_Settings_S=MPU_REGION_SIZE_256B
CORTEX_M7.Size_Spec=MPU_REGION_SIZE_32KB
CORTEX_M7.SubRegionDisable_Spec=0x0
CORTEX_M7.SubRegionDisable-Cortex_Memory_Protection_Unit_Region5_Settings=0xC0
CORTEX_M7.TypeExtField-Cortex_Memory_Protection_Unit_Region1_Settings=MPU_TEX_LEVEL1
CORTEX_M7.TypeExtField-Cortex_Memory_Protection_Unit_Region2_Settings=MPU_TEX_LEVEL0
CORTEX_M7.TypeExtField-Cortex_Memory_Protection_Unit_Region3_Settings=MPU_TEX_LEVEL1
CORTEX_M7.TypeExtField-Cortex_Memory_Protection_Unit_Region4_Settings=MPU_TEX_LEVEL1
CORTEX_M7.TypeExtField-Cortex_Memory_Protection_Unit_Region5_Settings=MPU_TEX_LEVEL1
CORTEX_M7.TypeExtField_Spec=MPU_TEX_LEVEL1
CORTEX_M7.default_mode_Activation=0
CRYP.Algorithm=CRYP_AES_GCM
CRYP.HeaderSize=1
CRYP.KeySize=CRYP_KEYSIZE_256B
DMA2D.ColorMode=DMA2D_OUTPUT_RGB565
Dma.Request0=UART5_RX
Dma.Request1=UART4_RX
Dma.Request2=USART2_RX
Dma.UART4_RX.1.Direction=DMA_PERIPH_TO_MEMORY
Dma.UART4_RX.1.EventEnable=DISABLE
Dma.UART4_RX.1.FIFOMode=DMA_FIFOMODE_DISABLE
Dma.UART4_RX.1.Instance=DMA1_Stream1
Dma.UART4_RX.1.MemDataAlignment=DMA_MDATAALIGN_BYTE
Dma.UART4_RX.1.MemInc=DMA_MINC_ENABLE
Dma.UART4_RX.1.Mode=DMA_NORMAL
Dma.UART4_RX.1.PeriphDataAlignment=DMA_PDATAALIGN_BYTE
Dma.UART4_RX.1.PeriphInc=DMA_PINC_DISABLE
Dma.UART4_RX.1.Polarity=HAL_DMAMUX_REQ_GEN_RISING
Dma.UART4_RX.1.Priority=DMA_PRIORITY_LOW
Dma.UART4_RX.1.RequestNumber=1
Dma.UART4_RX.1.SignalID=NONE
Dma.UART4_RX.1.SyncEnable=DISABLE
Dma.UART4_RX.1.SyncPolarity=HAL_DMAMUX_SYNC_NO_EVENT
Dma.UART4_RX.1.SyncRequestNumber=1
Dma.UART4_RX.1.SyncSignalID=NONE
Dma.UART5_RX.0.Direction=DMA_PERIPH_TO_MEMORY
Dma.UART5_RX.0.EventEnable=DISABLE
Dma.UART5_RX.0.FIFOMode=DMA_FIFOMODE_DISABLE
Dma.UART5_RX.0.Instance=DMA1_Stream0
Dma.UART5_RX.0.MemDataAlignment=DMA_MDATAALIGN_BYTE
Dma.UART5_RX.0.MemInc=DMA_MINC_ENABLE
Dma.UART5_RX.0.Mode=DMA_NORMAL
Dma.UART5_RX.0.PeriphDataAlignment=DMA_PDATAALIGN_BYTE
Dma.UART5_RX.0.PeriphInc=DMA_PINC_DISABLE
Dma.UART5_RX.0.Polarity=HAL_DMAMUX_REQ_GEN_RISING
Dma.UART5_RX.0.Priority=DMA_PRIORITY_LOW
Dma.UART5_RX.0.RequestNumber=1
Dma.UART5_RX.0.SignalID=NONE
Dma.UART5_RX.0.SyncEnable=DISABLE
Dma.UART5_RX.0.SyncPolarity=HAL_DMAMUX_SYNC_NO_EVENT
Dma.UART5_RX.0.SyncRequestNumber=1
Dma.UART5_RX.0.SyncSignalID=NONE
Dma.USART2_RX.2.Direction=DMA_PERIPH_TO_MEMORY
Dma.USART2_RX.2.EventEnable=DISABLE
Dma.USART2_RX.2.FIFOMode=DMA_FIFOMODE_DISABLE
Dma.USART2_RX.2.Instance=DMA1_Stream2
Dma.USART2_RX.2.MemDataAlignment=DMA_MDATAALIGN_BYTE
Dma.USART2_RX.2.MemInc=DMA_MINC_ENABLE
Dma.USART2_RX.2.Mode=DMA_NORMAL
Dma.USART2_RX.2.PeriphDataAlignment=DMA_PDATAALIGN_BYTE
Dma.USART2_RX.2.PeriphInc=DMA_PINC_DISABLE
Dma.USART2_RX.2.Polarity=HAL_DMAMUX_REQ_GEN_RISING
Dma.USART2_RX.2.Priority=DMA_PRIORITY_LOW
Dma.USART2_RX.2.RequestNumber=1
Dma.USART2_RX.2.SignalID=NONE
Dma.USART2_RX.2.SyncEnable=DISABLE
Dma.USART2_RX.2.SyncPolarity=HAL_DMAMUX_SYNC_NO_EVENT
Dma.USART2_RX.2.SyncRequestNumber=1
Dma.USART2_RX.2.SyncSignalID=NONE
ETH.MediaInterface=HAL_ETH_RMII_MODE
ETH.RxBuffLen=1536
ETH.RxDescAddress=0x30040000
ETH.TxDescAddress=0x30040060
FDCAN2.AutoRetransmission=ENABLE
FDCAN2.CalculateBaudRateNominal=500000
FDCAN2.CalculateTimeBitNominal=2000
FDCAN2.CalculateTimeQuantumNominal=25.0
FDCAN2.DataPrescaler=2
FDCAN2.DataSyncJumpWidth=4
FDCAN2.DataTimeSeg1=15
FDCAN2.DataTimeSeg2=4
FDCAN2.ExtFiltersNbr=32
FDCAN2.FrameFormat=FDCAN_FRAME_FD_BRS
FDCAN2.NominalPrescaler=2
FDCAN2.NominalSyncJumpWidth=16
FDCAN2.NominalTimeSeg1=63
FDCAN2.NominalTimeSeg2=16
FDCAN2.RxBufferSize=FDCAN_DATA_BYTES_64
FDCAN2.RxFifo0ElmtSize=FDCAN_DATA_BYTES_64
FDCAN2.RxFifo0ElmtsNbr=32
FDCAN2.RxFifo1ElmtSize=FDCAN_DATA_BYTES_64
FDCAN2.StdFiltersNbr=64
FDCAN2.TransmitPause=ENABLE
FDCAN2.TxElmtSize=FDCAN_DATA_BYTES_64
FDCAN2.TxFifoQueueElmtsNbr=16
FMC.CASLatency1=FMC_SDRAM_CAS_LATENCY_2
FMC.ColumnBitsNumber1=FMC_SDRAM_COLUMN_BITS_NUM_9
FMC.ExitSelfRefreshDelay1=8
FMC.LoadToActiveDelay1=2
FMC.RCDDelay1=2
FMC.RPDelay1=2
FMC.RPDelay2=2
FMC.ReadBurst1=FMC_SDRAM_RBURST_ENABLE
FMC.ReadBurst2=FMC_SDRAM_RBURST_ENABLE
FMC.RowCycleDelay1=6
FMC.RowCycleDelay2=6
FMC.SDClockPeriod1=FMC_SDRAM_CLOCK_PERIOD_2
FMC.SDClockPeriod2=FMC_SDRAM_CLOCK_PERIOD_2
FMC.SDMemoryDataWidth1-SdramChipSelect1_1=FMC_SDRAM_MEM_BUS_WIDTH_8
FMC.SelfRefreshTime1=5
FMC.WriteRecoveryTime1=3
FREERTOS.HEAP_NUMBER=4
FREERTOS.INCLUDE_eTaskGetState=1
FREERTOS.INCLUDE_uxTaskGetStackHighWaterMark=1
FREERTOS.MEMORY_ALLOCATION=2
FREERTOS.Mutexes01=DebugUartMutex,Dynamic,NULL
FREERTOS.Tasks01=startup_Thread,3,256,Startup,Default,NULL,Dynamic,NULL,NULL;TouchGFX,-1,3072,TouchGFX_Task,As weak,NULL,Dynamic,NULL,NULL
FREERTOS.configCHECK_FOR_STACK_OVERFLOW=0
FREERTOS.configENABLE_FPU=0
FREERTOS.configGENERATE_RUN_TIME_STATS=1
FREERTOS.configIDLE_SHOULD_YIELD=1
FREERTOS.configRECORD_STACK_HIGH_ADDRESS=1
FREERTOS.configTOTAL_HEAP_SIZE=307200
FREERTOS.configUSE_STATS_FORMATTING_FUNCTIONS=1
FREERTOS.configUSE_TIMERS=1
FREERTOS.configUSE_TRACE_FACILITY=1
HASH.SecureHashAlgorithmType=SHA256
LTDC.ActiveH=600
LTDC.ActiveW=1024
LTDC.Alpha_L0=255
LTDC.FBStartAdress_L0=0
LTDC.FBStartAdress_L1=BufStartAdd_2
LTDC.HBP=140
LTDC.HFP=160
LTDC.HSync=20
LTDC.ImageHeight_L0=600
LTDC.ImageHeight_L1=600
LTDC.ImageWidth_L0=1024
LTDC.Layers=0
LTDC.PixelFormat_L0=LTDC_PIXEL_FORMAT_RGB565
LTDC.VBP=20
LTDC.VFP=12
LTDC.VSync=3
LTDC.WindowX1_L0=1024
LTDC.WindowX1_L1=1024
LTDC.WindowY1_L0=600
LTDC.WindowY1_L1=600
LWIP.BSP.number=1
LWIP.DNS_DEBUG=LWIP_DBG_OFF
LWIP.LWIP_DBG_TYPES_ON=LWIP_DBG_ON
LWIP.LWIP_DNS=1
LWIP.LWIP_HTTPD=0
LWIP.LWIP_RAM_HEAP_POINTER=0x30020000
LWIP.LWIP_SMTP=0
LWIP.LWIP_SNTP=1
LWIP.MEMP_DEBUG=LWIP_DBG_OFF
LWIP.MEMP_NUM_PBUF=20
LWIP.MEM_SIZE=32*1024
LWIP.PBUF_POOL_BUFSIZE=2048
LWIP.SNTP_COMP_ROUNDTRIP=1
LWIP.SNTP_DEBUG=LWIP_DBG_OFF
LWIP.SNTP_MAX_SERVERS=4
LWIP.SOCKETS_DEBUG=LWIP_DBG_ON
LWIP.TCP_DEBUG=LWIP_DBG_ON
LWIP.TCP_MSS=1024
LWIP.TCP_SND_BUF=2048
LWIP.TCP_WND=5896
LWIP.UDP_DEBUG=LWIP_DBG_OFF
LWIP.Version=v2.1.2_Cube
LWIP0.BSP.STBoard=false
LWIP0.BSP.api=BSP_COMPONENT_DRIVER
LWIP0.BSP.component=LAN8742
LWIP0.BSP.instance=LAN8742
LWIP0.BSP.name=Driver_PHY
LWIP0.BSP.semaphore=S_LAN8742
LWIP0.BSP.solution=LAN8742
MBEDTLS.MBEDTLS_AES_ALT=0
MBEDTLS.MBEDTLS_CCM_ALT=0
MBEDTLS.MBEDTLS_DHM_C=0
MBEDTLS.MBEDTLS_ECDH_C=0
MBEDTLS.MBEDTLS_ECDSA_C=0
MBEDTLS.MBEDTLS_GCM_ALT=0
MBEDTLS.MBEDTLS_HAVE_TIME=1
MBEDTLS.MBEDTLS_HAVE_TIME_DATE=1
MBEDTLS.MBEDTLS_KEY_EXCHANGE_DHE_PSK_ENABLED=0
MBEDTLS.MBEDTLS_KEY_EXCHANGE_DHE_RSA_ENABLED=0
MBEDTLS.MBEDTLS_MD5_ALT=1
MBEDTLS.MBEDTLS_PLATFORM_MEMORY=1
MBEDTLS.MBEDTLS_SHA1_ALT=1
MBEDTLS.MBEDTLS_SHA256_ALT=1
MBEDTLS.MBEDTLS_SSL_SRV_C=0
Mcu.Family=STM32H7
Mcu.Name=STM32H750IBTx
Mcu.Package=LQFP176
Mcu.UserConstants=BufStartAdd_3,0xC0258000;BufStartAdd_1,0xC0000000;BufStartAdd_2,0xC012C000;StationBuffAdd,0xC03AF000;ETHSendBuffAdd,0xC0384000;CANRevBuffStartAdd,0xC03B0000;CANSndBuffStartAdd,0xC03F8000
NVIC.DMA1_Stream0_IRQn=true\:5\:0\:true\:false\:true\:true\:false\:true\:true
NVIC.DMA1_Stream1_IRQn=true\:5\:0\:false\:false\:true\:true\:false\:true\:true
NVIC.DMA1_Stream2_IRQn=true\:5\:0\:false\:false\:true\:true\:false\:true\:true
NVIC.DMA2D_IRQn=true\:9\:0\:true\:false\:true\:true\:true\:true\:true
NVIC.ETH_IRQn=true\:5\:0\:true\:false\:true\:true\:true\:true\:true
NVIC.FDCAN2_IT0_IRQn=true\:6\:0\:true\:false\:true\:true\:true\:true\:true
NVIC.LTDC_IRQn=true\:9\:0\:true\:false\:true\:true\:true\:true\:true
NVIC.PriorityGroup=NVIC_PRIORITYGROUP_4
NVIC.TIM6_DAC_IRQn=true\:15\:0\:true\:false\:true\:true\:true\:true\:true
NVIC.TIM7_IRQn=true\:15\:0\:true\:false\:true\:false\:false\:true\:true
NVIC.TimeBase=TIM7_IRQn
NVIC.TimeBaseIP=TIM7
NVIC.UART4_IRQn=true\:5\:0\:false\:false\:true\:true\:true\:true\:true
NVIC.UART5_IRQn=true\:5\:0\:false\:false\:true\:true\:true\:true\:true
NVIC.USART2_IRQn=true\:5\:0\:false\:false\:true\:true\:true\:true\:true
PA0.GPIO_Label=ETH_RESET
PA0.PinAttribute=Free
PA0.PinState=GPIO_PIN_SET
PA0.Signal=GPIO_Output
PA1.GPIO_Speed=GPIO_SPEED_FREQ_VERY_HIGH
PA1.Mode=RMII
PA1.PinAttribute=Free
PA1.Signal=ETH_REF_CLK
PA10.GPIO_Speed=GPIO_SPEED_FREQ_VERY_HIGH
PA10.Mode=RGB565
PA10.PinAttribute=Free
PA10.Signal=LTDC_B4
PA12.PinAttribute=Free
PA12.Signal=FDCAN1_TX
PA13\ (JTMS/SWDIO).Mode=Serial_Wire
PA13\ (JTMS/SWDIO).PinAttribute=Free
PA13\ (JTMS/SWDIO).Signal=DEBUG_JTMS-SWDIO
PA14\ (JTCK/SWCLK).Mode=Serial_Wire
PA14\ (JTCK/SWCLK).PinAttribute=Free
PA14\ (JTCK/SWCLK).Signal=DEBUG_JTCK-SWCLK
PA15\ (JTDI).GPIO_Label=BEEP
PA15\ (JTDI).PinAttribute=Free
PA15\ (JTDI).Signal=GPIO_Output
PA2.GPIO_Speed=GPIO_SPEED_FREQ_VERY_HIGH
PA2.Mode=RMII
PA2.PinAttribute=Free
PA2.Signal=ETH_MDIO
PA3.GPIO_Speed=GPIO_SPEED_FREQ_VERY_HIGH
PA3.Mode=RGB565
PA3.Signal=LTDC_B5
PA4.GPIO_Speed=GPIO_SPEED_FREQ_VERY_HIGH
PA4.Mode=RGB565
PA4.PinAttribute=Free
PA4.Signal=LTDC_VSYNC
PA5.GPIO_Speed=GPIO_SPEED_FREQ_VERY_HIGH
PA5.Mode=RGB565
PA5.PinAttribute=Free
PA5.Signal=LTDC_R4
PA6.GPIO_Speed=GPIO_SPEED_FREQ_VERY_HIGH
PA6.Mode=RGB565
PA6.PinAttribute=Free
PA6.Signal=LTDC_G2
PA7.GPIO_Speed=GPIO_SPEED_FREQ_VERY_HIGH
PA7.Mode=RMII
PA7.PinAttribute=Free
PA7.Signal=ETH_CRS_DV
PA8.GPIO_Speed=GPIO_SPEED_FREQ_VERY_HIGH
PA8.Mode=RGB565
PA8.PinAttribute=Free
PA8.Signal=LTDC_B3
PA9.GPIO_Speed=GPIO_SPEED_FREQ_VERY_HIGH
PA9.Mode=Full_Duplex_Master
PA9.PinAttribute=Free
PA9.Signal=SPI2_SCK
PB0.GPIO_Speed=GPIO_SPEED_FREQ_VERY_HIGH
PB0.Mode=RGB565
PB0.PinAttribute=Free
PB0.Signal=LTDC_R3
PB1.GPIO_Speed=GPIO_SPEED_FREQ_VERY_HIGH
PB1.Mode=RGB565
PB1.PinAttribute=Free
PB1.Signal=LTDC_R6
PB10.GPIO_PuPd=GPIO_PULLUP
PB10.GPIO_Speed=GPIO_SPEED_FREQ_VERY_HIGH
PB10.Mode=Single Bank 1
PB10.PinAttribute=Free
PB10.Signal=QUADSPI_BK1_NCS
PB11.GPIO_Speed=GPIO_SPEED_FREQ_VERY_HIGH
PB11.Mode=RGB565
PB11.PinAttribute=Free
PB11.Signal=LTDC_G5
PB12.Mode=FDCAN_Activate
PB12.PinAttribute=Free
PB12.Signal=FDCAN2_RX
PB13.Mode=FDCAN_Activate
PB13.PinAttribute=Free
PB13.Signal=FDCAN2_TX
PB14.GPIO_Speed=GPIO_SPEED_FREQ_VERY_HIGH
PB14.Mode=Full_Duplex_Master
PB14.PinAttribute=Free
PB14.Signal=SPI2_MISO
PB15.GPIO_Speed=GPIO_SPEED_FREQ_VERY_HIGH
PB15.Mode=Full_Duplex_Master
PB15.PinAttribute=Free
PB15.Signal=SPI2_MOSI
PB2.GPIO_PuPd=GPIO_PULLUP
PB2.GPIO_Speed=GPIO_SPEED_FREQ_VERY_HIGH
PB2.Mode=Single Bank 1
PB2.PinAttribute=Free
PB2.Signal=QUADSPI_CLK
PB3\ (JTDO/TRACESWO).GPIO_Label=LCD_RESET
PB3\ (JTDO/TRACESWO).PinAttribute=Free
PB3\ (JTDO/TRACESWO).PinState=GPIO_PIN_SET
PB3\ (JTDO/TRACESWO).Signal=GPIO_Output
PB4\ (NJTRST).GPIO_Label=T_CS
PB4\ (NJTRST).PinAttribute=Free
PB4\ (NJTRST).PinState=GPIO_PIN_SET
PB4\ (NJTRST).Signal=GPIO_Output
PB5.GPIO_Label=T_PEN
PB5.PinAttribute=Free
PB5.Signal=GPIO_Input
PB6.GPIO_Label=T_IC2_SCL
PB6.GPIO_Speed=GPIO_SPEED_FREQ_VERY_HIGH
PB6.PinAttribute=Free
PB6.PinState=GPIO_PIN_SET
PB6.Signal=GPIO_Output
PB7.GPIO_Label=T_IC2_SDA
PB7.GPIO_Speed=GPIO_SPEED_FREQ_VERY_HIGH
PB7.PinAttribute=Free
PB7.PinState=GPIO_PIN_SET
PB7.Signal=GPIO_Output
PB8.GPIO_Speed=GPIO_SPEED_FREQ_VERY_HIGH
PB8.Mode=RGB565
PB8.PinAttribute=Free
PB8.Signal=LTDC_B6
PB9.GPIO_Speed=GPIO_SPEED_FREQ_VERY_HIGH
PB9.Mode=RGB565
PB9.PinAttribute=Free
PB9.Signal=LTDC_B7
PC0.GPIO_Speed=GPIO_SPEED_FREQ_VERY_HIGH
PC0.Mode=RGB565
PC0.PinAttribute=Free
PC0.Signal=LTDC_R5
PC1.GPIO_Speed=GPIO_SPEED_FREQ_VERY_HIGH
PC1.Mode=RMII
PC1.PinAttribute=Free
PC1.Signal=ETH_MDC
PC10.Mode=Asynchronous
PC10.PinAttribute=Free
PC10.Signal=UART4_TX
PC11.Mode=Asynchronous
PC11.PinAttribute=Free
PC11.Signal=UART4_RX
PC12.Mode=Asynchronous
PC12.PinAttribute=Free
PC12.Signal=UART5_TX
PC13.GPIO_Label=MCU_ACTIVE
PC13.PinAttribute=Free
PC13.Signal=GPIO_Output
PC14-OSC32_IN\ (OSC32_IN).Mode=LSE-External-Oscillator
PC14-OSC32_IN\ (OSC32_IN).PinAttribute=Free
PC14-OSC32_IN\ (OSC32_IN).Signal=RCC_OSC32_IN
PC15-OSC32_OUT\ (OSC32_OUT).Mode=LSE-External-Oscillator
PC15-OSC32_OUT\ (OSC32_OUT).PinAttribute=Free
PC15-OSC32_OUT\ (OSC32_OUT).Signal=RCC_OSC32_OUT
PC2_C.GPIO_Speed_High_Default=GPIO_SPEED_FREQ_VERY_HIGH
PC2_C.Mode=SdramChipSelect1_1
PC2_C.PinAttribute=Free
PC2_C.Signal=FMC_SDNE0
PC3_C.GPIO_Speed_High_Default=GPIO_SPEED_FREQ_VERY_HIGH
PC3_C.Mode=SdramChipSelect1_1
PC3_C.PinAttribute=Free
PC3_C.Signal=FMC_SDCKE0
PC4.GPIO_Speed=GPIO_SPEED_FREQ_VERY_HIGH
PC4.Mode=RMII
PC4.PinAttribute=Free
PC4.Signal=ETH_RXD0
PC5.GPIO_Speed=GPIO_SPEED_FREQ_VERY_HIGH
PC5.Mode=RMII
PC5.PinAttribute=Free
PC5.Signal=ETH_RXD1
PC6.GPIO_Speed=GPIO_SPEED_FREQ_VERY_HIGH
PC6.Mode=RGB565
PC6.PinAttribute=Free
PC6.Signal=LTDC_HSYNC
PC7.GPIO_Label=LCD_BL
PC7.PinAttribute=Free
PC7.Signal=GPIO_Output
PC9.GPIO_Label=SPI2_NSS
PC9.PinAttribute=Free
PC9.PinState=GPIO_PIN_SET
PC9.Signal=GPIO_Output
PD0.GPIO_Speed_High_Default=GPIO_SPEED_FREQ_VERY_HIGH
PD0.PinAttribute=Free
PD0.Signal=FMC_D2_DA2
PD1.GPIO_Speed_High_Default=GPIO_SPEED_FREQ_VERY_HIGH
PD1.PinAttribute=Free
PD1.Signal=FMC_D3_DA3
PD10.GPIO_Speed_High_Default=GPIO_SPEED_FREQ_VERY_HIGH
PD10.PinAttribute=Free
PD10.Signal=FMC_D15_DA15
PD12.GPIO_Label=AT24CXX_SCL
PD12.GPIO_Speed=GPIO_SPEED_FREQ_VERY_HIGH
PD12.PinAttribute=Free
PD12.PinState=GPIO_PIN_SET
PD12.Signal=GPIO_Output
PD13.GPIO_Label=AT24CXX_SDA
PD13.GPIO_Speed=GPIO_SPEED_FREQ_VERY_HIGH
PD13.PinAttribute=Free
PD13.PinState=GPIO_PIN_SET
PD13.Signal=GPIO_Output
PD14.GPIO_Speed_High_Default=GPIO_SPEED_FREQ_VERY_HIGH
PD14.PinAttribute=Free
PD14.Signal=FMC_D0_DA0
PD15.GPIO_Speed_High_Default=GPIO_SPEED_FREQ_VERY_HIGH
PD15.PinAttribute=Free
PD15.Signal=FMC_D1_DA1
PD2.Mode=Asynchronous
PD2.PinAttribute=Free
PD2.Signal=UART5_RX
PD3.GPIO_Speed=GPIO_SPEED_FREQ_VERY_HIGH
PD3.Mode=RGB565
PD3.PinAttribute=Free
PD3.Signal=LTDC_G7
PD4.GPIO_Label=EC600_RST
PD4.GPIO_PuPd=GPIO_PULLUP
PD4.PinAttribute=Free
PD4.PinState=GPIO_PIN_SET
PD4.Signal=GPIO_Output
PD5.Mode=Asynchronous
PD5.PinAttribute=Free
PD5.Signal=USART2_TX
PD6.Mode=Asynchronous
PD6.PinAttribute=Free
PD6.Signal=USART2_RX
PD8.GPIO_Speed_High_Default=GPIO_SPEED_FREQ_VERY_HIGH
PD8.PinAttribute=Free
PD8.Signal=FMC_D13_DA13
PD9.GPIO_Speed_High_Default=GPIO_SPEED_FREQ_VERY_HIGH
PD9.PinAttribute=Free
PD9.Signal=FMC_D14_DA14
PE0.GPIO_Speed_High_Default=GPIO_SPEED_FREQ_VERY_HIGH
PE0.PinAttribute=Free
PE0.Signal=FMC_NBL0
PE1.GPIO_Speed_High_Default=GPIO_SPEED_FREQ_VERY_HIGH
PE1.PinAttribute=Free
PE1.Signal=FMC_NBL1
PE10.GPIO_Speed_High_Default=GPIO_SPEED_FREQ_VERY_HIGH
PE10.PinAttribute=Free
PE10.Signal=FMC_D7_DA7
PE11.GPIO_Speed_High_Default=GPIO_SPEED_FREQ_VERY_HIGH
PE11.PinAttribute=Free
PE11.Signal=FMC_D8_DA8
PE12.GPIO_Speed_High_Default=GPIO_SPEED_FREQ_VERY_HIGH
PE12.PinAttribute=Free
PE12.Signal=FMC_D9_DA9
PE13.PinAttribute=Free
PE13.Signal=FMC_D10_DA10
PE14.PinAttribute=Free
PE14.Signal=FMC_D11_DA11
PE15.PinAttribute=Free
PE15.Signal=FMC_D12_DA12
PE2.GPIO_Label=LED_G
PE2.PinAttribute=Free
PE2.Signal=GPIO_Output
PE3.GPIO_Label=LED_B
PE3.PinAttribute=Free
PE3.Signal=GPIO_Output
PE4.GPIO_Label=VSYNC_FREQ
PE4.PinAttribute=Free
PE4.Signal=GPIO_Output
PE5.GPIO_Label=RENDER_TIME
PE5.PinAttribute=Free
PE5.Signal=GPIO_Output
PE6.GPIO_Label=FRAME_RATE
PE6.PinAttribute=Free
PE6.Signal=GPIO_Output
PE7.GPIO_Speed_High_Default=GPIO_SPEED_FREQ_VERY_HIGH
PE7.PinAttribute=Free
PE7.Signal=FMC_D4_DA4
PE8.GPIO_Speed_High_Default=GPIO_SPEED_FREQ_VERY_HIGH
PE8.PinAttribute=Free
PE8.Signal=FMC_D5_DA5
PE9.GPIO_Speed_High_Default=GPIO_SPEED_FREQ_VERY_HIGH
PE9.PinAttribute=Free
PE9.Signal=FMC_D6_DA6
PF0.PinAttribute=Free
PF0.Signal=FMC_A0
PF1.PinAttribute=Free
PF1.Signal=FMC_A1
PF10.GPIO_Speed=GPIO_SPEED_FREQ_VERY_HIGH
PF10.Mode=RGB565
PF10.PinAttribute=Free
PF10.Signal=LTDC_DE
PF11.PinAttribute=Free
PF11.Signal=FMC_SDNRAS
PF12.PinAttribute=Free
PF12.Signal=FMC_A6
PF13.PinAttribute=Free
PF13.Signal=FMC_A7
PF14.PinAttribute=Free
PF14.Signal=FMC_A8
PF15.Signal=FMC_A9
PF2.PinAttribute=Free
PF2.Signal=FMC_A2
PF3.PinAttribute=Free
PF3.Signal=FMC_A3
PF4.Signal=FMC_A4
PF5.Signal=FMC_A5
PF6.GPIO_Speed=GPIO_SPEED_FREQ_VERY_HIGH
PF6.Mode=Single Bank 1
PF6.PinAttribute=Free
PF6.Signal=QUADSPI_BK1_IO3
PF7.GPIO_Speed=GPIO_SPEED_FREQ_VERY_HIGH
PF7.Mode=Single Bank 1
PF7.PinAttribute=Free
PF7.Signal=QUADSPI_BK1_IO2
PF8.GPIO_Speed=GPIO_SPEED_FREQ_VERY_HIGH
PF8.Mode=Single Bank 1
PF8.PinAttribute=Free
PF8.Signal=QUADSPI_BK1_IO0
PF9.GPIO_Speed=GPIO_SPEED_FREQ_VERY_HIGH
PF9.Mode=Single Bank 1
PF9.PinAttribute=Free
PF9.Signal=QUADSPI_BK1_IO1
PG0.Signal=FMC_A10
PG1.PinAttribute=Free
PG1.Signal=FMC_A11
PG10.GPIO_Speed=GPIO_SPEED_FREQ_VERY_HIGH
PG10.Mode=RGB565
PG10.PinAttribute=Free
PG10.Signal=LTDC_G3
PG11.GPIO_Speed=GPIO_SPEED_FREQ_VERY_HIGH
PG11.Mode=RMII
PG11.PinAttribute=Free
PG11.Signal=ETH_TX_EN
PG13.GPIO_Speed=GPIO_SPEED_FREQ_VERY_HIGH
PG13.Mode=RMII
PG13.PinAttribute=Free
PG13.Signal=ETH_TXD0
PG14.GPIO_Speed=GPIO_SPEED_FREQ_VERY_HIGH
PG14.Mode=RMII
PG14.PinAttribute=Free
PG14.Signal=ETH_TXD1
PG15.PinAttribute=Free
PG15.Signal=FMC_SDNCAS
PG2.PinAttribute=Free
PG2.Signal=FMC_A12
PG4.PinAttribute=Free
PG4.Signal=FMC_A14_BA0
PG5.PinAttribute=Free
PG5.Signal=FMC_A15_BA1
PG6.GPIO_Speed=GPIO_SPEED_FREQ_VERY_HIGH
PG6.Mode=RGB565
PG6.PinAttribute=Free
PG6.Signal=LTDC_R7
PG7.GPIO_Speed=GPIO_SPEED_FREQ_VERY_HIGH
PG7.Mode=RGB565
PG7.PinAttribute=Free
PG7.Signal=LTDC_CLK
PG8.PinAttribute=Free
PG8.Signal=FMC_SDCLK
PG9.GPIO_Label=EC600_EN
PG9.PinAttribute=Free
PG9.PinState=GPIO_PIN_SET
PG9.Signal=GPIO_Output
PH0-OSC_IN\ (PH0).Mode=HSE-External-Oscillator
PH0-OSC_IN\ (PH0).PinAttribute=Free
PH0-OSC_IN\ (PH0).Signal=RCC_OSC_IN
PH1-OSC_OUT\ (PH1).Mode=HSE-External-Oscillator
PH1-OSC_OUT\ (PH1).PinAttribute=Free
PH1-OSC_OUT\ (PH1).Signal=RCC_OSC_OUT
PH10.PinAttribute=Free
PH10.Signal=FMC_D18
PH11.PinAttribute=Free
PH11.Signal=FMC_D19
PH12.PinAttribute=Free
PH12.Signal=FMC_D20
PH13.PinAttribute=Free
PH13.Signal=FMC_D21
PH14.PinAttribute=Free
PH14.Signal=FMC_D22
PH15.PinAttribute=Free
PH15.Signal=FMC_D23
PH4.GPIO_Speed=GPIO_SPEED_FREQ_VERY_HIGH
PH4.Mode=RGB565
PH4.PinAttribute=Free
PH4.Signal=LTDC_G4
PH5.PinAttribute=Free
PH5.Signal=FMC_SDNWE
PH8.PinAttribute=Free
PH8.Signal=FMC_D16
PH9.Signal=FMC_D17
PI0.PinAttribute=Free
PI0.Signal=FMC_D24
PI1.PinAttribute=Free
PI1.Signal=FMC_D25
PI10.PinAttribute=Free
PI10.Signal=FMC_D31
PI11.GPIO_Speed=GPIO_SPEED_FREQ_VERY_HIGH
PI11.Mode=RGB565
PI11.PinAttribute=Free
PI11.Signal=LTDC_G6
PI2.PinAttribute=Free
PI2.Signal=FMC_D26
PI3.PinAttribute=Free
PI3.Signal=FMC_D27
PI4.PinAttribute=Free
PI4.Signal=FMC_NBL2
PI5.PinAttribute=Free
PI5.Signal=FMC_NBL3
PI6.Signal=FMC_D28
PI7.PinAttribute=Free
PI7.Signal=FMC_D29
PI9.PinAttribute=Free
PI9.Signal=FMC_D30
ProjectManager.HeapSize=0x400
ProjectManager.StackSize=0x400
ProjectManager.TargetToolchain=MDK-ARM V5.32
QUADSPI.ChipSelectHighTime=QSPI_CS_HIGH_TIME_5_CYCLE
QUADSPI.ClockPrescaler=1
QUADSPI.FifoThreshold=4
QUADSPI.FlashSize=22
QUADSPI.SampleShifting=QSPI_SAMPLE_SHIFTING_HALFCYCLE
RCC.ADCCLockSelection=RCC_ADCCLKSOURCE_PLL2
RCC.ADCFreq_Value=200000000
RCC.APB1Freq_Value=120000000
RCC.APB2Freq_Value=120000000
RCC.APB3Freq_Value=120000000
RCC.APB4Freq_Value=120000000
RCC.CECCLockSelection=RCC_CECCLKSOURCE_LSI
RCC.CKPERSourceSelection=RCC_CLKPSOURCE_HSE
RCC.CSI_VALUE=4000000
RCC.CortexFreq_Value=480000000
RCC.Cortex_DivARG=SystemCoreClock/1000
RCC.D1PPRE=RCC_APB3_DIV2
RCC.D2PPRE1=RCC_APB1_DIV2
RCC.D2PPRE2=RCC_APB2_DIV2
RCC.D3PPRE=RCC_APB4_DIV2
RCC.DFSDMCLockSelection=RCC_DFSDM1CLKSOURCE_D2PCLK1
RCC.DIVM1=5
RCC.DIVM2=5
RCC.DIVM3=5
RCC.DIVN1=192
RCC.DIVN2=120
RCC.DIVN3=90
RCC.DIVP2=3
RCC.DIVQ1=12
RCC.DIVQ2=3
RCC.DIVR2=3
RCC.DIVR3=9
RCC.DSICLockSelection=RCC_DSICLKSOURCE_PHY
RCC.DSIPHY_Div=8
RCC.DSITX_Div=4
RCC.DSI_PHY_VALUE=12288000
RCC.EXTERNAL_CLOCK_VALUE=12288000
RCC.EnbaleCSS=true
RCC.FDCANCLockSelection=RCC_FDCANCLKSOURCE_PLL
RCC.FMCCLockSelection=RCC_FMCCLKSOURCE_PLL2
RCC.HCLKFreq_Value=240000000
RCC.HPRE=RCC_HCLK_DIV2
RCC.HSE_Timout=100
RCC.HSE_VALUE=25000000
RCC.HSI_VALUE=64000000
RCC.I2C123CLockSelection=RCC_I2C123CLKSOURCE_D2PCLK1
RCC.I2C4CLockSelection=RCC_I2C4CLKSOURCE_D3PCLK1
RCC.LPTIM1CLockSelection=RCC_LPTIM1CLKSOURCE_D2PCLK1
RCC.LPTIM2CLockSelection=RCC_LPTIM2CLKSOURCE_D3PCLK1
RCC.LPTIM345CLockSelection=RCC_LPTIM345CLKSOURCE_D3PCLK1
RCC.LPUART1CLockSelection=RCC_LPUART1CLKSOURCE_D3PCLK1
RCC.PLL1_VCI_Range-AdvancedSettings=RCC_PLL1VCIRANGE_0
RCC.PLL1_VCO_SEL-AdvancedSettings=RCC_PLL1VCOMEDIUM
RCC.PLL2FRACN=0
RCC.PLL2_VCI_Range-AdvancedSettings=RCC_PLL2VCIRANGE_0
RCC.PLL3FRACN=0
RCC.PLL3_VCI_Range-AdvancedSettings=RCC_PLL3VCIRANGE_3
RCC.PLL3_VCO_SEL-AdvancedSettings=RCC_PLL3VCOWIDE
RCC.PLLDSIDev=2
RCC.PLLDSIIDF=DSI_PLL_IN_DIV1
RCC.PLLDSIMult=2
RCC.PLLDSINDIV=20
RCC.PLLDSIODF=DSI_PLL_OUT_DIV1
RCC.PLLFRACN=0
RCC.PLLSourceVirtual=RCC_PLLSOURCE_HSE
RCC.PWR_Regulator_Voltage_Scale=PWR_REGULATOR_VOLTAGE_SCALE0
RCC.ProductRev=revV
RCC.QSPICLockSelection=RCC_QSPICLKSOURCE_PLL
RCC.RC48_VALUE=48000000
RCC.RCC_MCO1Source=RCC_MCO1SOURCE_HSI
RCC.RCC_MCO2Source=RCC_MCO2SOURCE_SYSCLK
RCC.RCC_RTC_Clock_Source_FROM_HSE=RCC_RTCCLKSOURCE_HSE_DIV63
RCC.RNGCLockSelection=RCC_RNGCLKSOURCE_PLL
RCC.SAI1CLockSelection=RCC_SAI1CLKSOURCE_PLL
RCC.SAI23CLockSelection=RCC_SAI23CLKSOURCE_PLL
RCC.SAI4ACLockSelection=RCC_SAI4ACLKSOURCE_PLL
RCC.SAI4BCLockSelection=RCC_SAI4BCLKSOURCE_PLL
RCC.SPDIFCLockSelection=RCC_SPDIFRXCLKSOURCE_PLL
RCC.SPI6CLockSelection=RCC_SPI6CLKSOURCE_D3PCLK1
RCC.SWPCLockSelection=RCC_SWPMI1CLKSOURCE_D2PCLK1
RCC.SYSCLKFreq_VALUE=480000000
RCC.SYSCLKSource=RCC_SYSCLKSOURCE_PLLCLK
RCC.Spi45ClockSelection=RCC_SPI45CLKSOURCE_D2PCLK1
RCC.SupplySource=PWR_LDO_SUPPLY
RCC.USART16CLockSelection=RCC_USART16CLKSOURCE_D2PCLK2
RCC.USART234578CLockSelection=RCC_USART234578CLKSOURCE_D2PCLK1
RCC.USBCLockSelection=RCC_USBCLKSOURCE_PLL
RCC.USBFreq_Value=80000000
SH.FMC_A0.0=FMC_A0,13b-sda1
SH.FMC_A1.0=FMC_A1,13b-sda1
SH.FMC_A10.0=FMC_A10,13b-sda1
SH.FMC_A11.0=FMC_A11,13b-sda1
SH.FMC_A12.0=FMC_A12,13b-sda1
SH.FMC_A14_BA0.0=FMC_BA0,FourSdramBanks1
SH.FMC_A15_BA1.0=FMC_BA1,FourSdramBanks1
SH.FMC_A2.0=FMC_A2,13b-sda1
SH.FMC_A3.0=FMC_A3,13b-sda1
SH.FMC_A4.0=FMC_A4,13b-sda1
SH.FMC_A5.0=FMC_A5,13b-sda1
SH.FMC_A6.0=FMC_A6,13b-sda1
SH.FMC_A7.0=FMC_A7,13b-sda1
SH.FMC_A8.0=FMC_A8,13b-sda1
SH.FMC_A9.0=FMC_A9,13b-sda1
SH.FMC_D0_DA0.0=FMC_D0,sd-32b-d1
SH.FMC_D10_DA10.0=FMC_D10,sd-32b-d1
SH.FMC_D11_DA11.0=FMC_D11,sd-32b-d1
SH.FMC_D12_DA12.0=FMC_D12,sd-32b-d1
SH.FMC_D13_DA13.0=FMC_D13,sd-32b-d1
SH.FMC_D14_DA14.0=FMC_D14,sd-32b-d1
SH.FMC_D15_DA15.0=FMC_D15,sd-32b-d1
SH.FMC_D16.0=FMC_D16,sd-32b-d1
SH.FMC_D17.0=FMC_D17,sd-32b-d1
SH.FMC_D18.0=FMC_D18,sd-32b-d1
SH.FMC_D19.0=FMC_D19,sd-32b-d1
SH.FMC_D1_DA1.0=FMC_D1,sd-32b-d1
SH.FMC_D20.0=FMC_D20,sd-32b-d1
SH.FMC_D21.0=FMC_D21,sd-32b-d1
SH.FMC_D22.0=FMC_D22,sd-32b-d1
SH.FMC_D23.0=FMC_D23,sd-32b-d1
SH.FMC_D24.0=FMC_D24,sd-32b-d1
SH.FMC_D25.0=FMC_D25,sd-32b-d1
SH.FMC_D26.0=FMC_D26,sd-32b-d1
SH.FMC_D27.0=FMC_D27,sd-32b-d1
SH.FMC_D28.0=FMC_D28,sd-32b-d1
SH.FMC_D29.0=FMC_D29,sd-32b-d1
SH.FMC_D2_DA2.0=FMC_D2,sd-32b-d1
SH.FMC_D30.0=FMC_D30,sd-32b-d1
SH.FMC_D31.0=FMC_D31,sd-32b-d1
SH.FMC_D3_DA3.0=FMC_D3,sd-32b-d1
SH.FMC_D4_DA4.0=FMC_D4,sd-32b-d1
SH.FMC_D5_DA5.0=FMC_D5,sd-32b-d1
SH.FMC_D6_DA6.0=FMC_D6,sd-32b-d1
SH.FMC_D7_DA7.0=FMC_D7,sd-32b-d1
SH.FMC_D8_DA8.0=FMC_D8,sd-32b-d1
SH.FMC_D9_DA9.0=FMC_D9,sd-32b-d1
SH.FMC_NBL0.0=FMC_NBL0,Sd4ByteEnable1
SH.FMC_NBL1.0=FMC_NBL1,Sd4ByteEnable1
SH.FMC_NBL2.0=FMC_NBL2,Sd4ByteEnable1
SH.FMC_NBL3.0=FMC_NBL3,Sd4ByteEnable1
SH.FMC_SDCLK.0=FMC_SDCLK,13b-sda1
SH.FMC_SDNCAS.0=FMC_SDNCAS,13b-sda1
SH.FMC_SDNRAS.0=FMC_SDNRAS,13b-sda1
SH.FMC_SDNWE.0=FMC_SDNWE,13b-sda1
SPI2.CalculateBaudRate=40.0 MBits/s
SPI2.DataSize=SPI_DATASIZE_8BIT
SPI2.Direction=SPI_DIRECTION_2LINES
SPI2.MasterKeepIOState=SPI_MASTER_KEEP_IO_STATE_DISABLE
SPI2.Mode=SPI_MODE_MASTER
SPI2.NSSPMode=SPI_NSS_PULSE_DISABLE
SPI2.VirtualType=VM_MASTER
STMicroelectronics.X-CUBE-TOUCHGFX.4.21.4.ApplicationCcGraphicsJjApplication=TouchGFXOoGenerator
STMicroelectronics.X-CUBE-TOUCHGFX.4.21.4.tgfx_address1=0xC0000000
STMicroelectronics.X-CUBE-TOUCHGFX.4.21.4.tgfx_address2=0xC012C000
STMicroelectronics.X-CUBE-TOUCHGFX.4.21.4.tgfx_buffering_strategy=Double
STMicroelectronics.X-CUBE-TOUCHGFX.4.21.4.tgfx_display_interface=disp_ltdc
STMicroelectronics.X-CUBE-TOUCHGFX.4.21.4.tgfx_hardware_accelerator=dma_2d
STMicroelectronics.X-CUBE-TOUCHGFX.4.21.4.tgfx_location=By Address
STMicroelectronics.X-CUBE-TOUCHGFX.4.21.4.tgfx_vsync=vsync_ltdc
STMicroelectronics.X-CUBE-TOUCHGFX.4.21.4_IsPackSelfContextualization=true
TIM6.AutoReloadPreload=TIM_AUTORELOAD_PRELOAD_ENABLE
TIM6.Period=99
TIM6.Prescaler=199
UART4.BaudRate=2000000
UART5.SwapParam=UART_ADVFEATURE_SWAP_DISABLE
USART2.SwapParam=ADVFEATURE_SWAP_DISABLE
USART2.VirtualMode-Asynchronous=VM_ASYNC
VP_CRC_VS_CRC.Mode=CRC_Activate
VP_CRYP_VS_CRYP.Mode=CRYP_Activate
VP_DMA2D_VS_DMA2D.Mode=DMA2D_Activate
VP_FREERTOS_VS_CMSIS_V1.Mode=CMSIS_V1
VP_HASH_VS_HASH.Mode=HASH_Activate
VP_LWIP_VS_Enabled.Mode=Enabled
VP_MBEDTLS_VS_MBEDTLS.Mode=Enabled
VP_RNG_VS_RNG.Mode=RNG_Activate
VP_RTC_VS_RTC_Activate.Mode=RTC_Enabled
VP_STMicroelectronics.X-CUBE-TOUCHGFX_VS_GraphicsJjApplication_4.21.4.Mode=GraphicsJjApplication
VP_SYS_VS_tim7.Mode=TIM7
VP_TIM6_VS_ClockSourceINT.Mode=Enable_Timer
VP_WWDG1_VS_WWDG.Mode=WWDG_Activate
WWDG1.Counter=127
WWDG1.Prescaler=WWDG_PRESCALER_128
WWDG1.Window=96
board=custom
wolfSSL.I-CUBE-wolfSSL.5.6.3.WOLF_CONF_BASE64_ENCODE=1
wolfSSL.I-CUBE-wolfSSL.5.6.3.WOLF_CONF_DEBUG=0
wolfSSL.I-CUBE-wolfSSL.5.6.3.WOLF_CONF_MATH=6
wolfSSL.I-CUBE-wolfSSL.5.6.3.WOLF_CONF_PSK=0
wolfSSL.I-CUBE-wolfSSL.5.6.3.WOLF_CONF_RTOS=2
wolfSSL.I-CUBE-wolfSSL.5.6.3.WOLF_CONF_SHA1=1
wolfSSL.I-CUBE-wolfSSL.5.6.3.WOLF_CONF_SHA2_384=1
wolfSSL.I-CUBE-wolfSSL.5.6.3.WOLF_CONF_TEST=0

// file: Core/Src/main.c
/* USER CODE BEGIN Header */
/**
  ******************************************************************************
  * @file           : main.c
  * @brief          : Main program body
  ******************************************************************************
  * @attention
  *
  * Copyright (c) 2022 STMicroelectronics.
  * All rights reserved.
  *
  * This software is licensed under terms that can be found in the LICENSE file
  * in the root directory of this software component.
  * If no LICENSE file comes with this software, it is provided AS-IS.
  *
  ******************************************************************************
  */
/* USER CODE END Header */
#include "main.h"
#include "cmsis_os.h"
#include "crc.h"
#include "dma.h"
#include "dma2d.h"
#include "fdcan.h"
#include "ltdc.h"
#include "rng.h"
#include "rtc.h"
#include "spi.h"
#include "tim.h"
#include "usart.h"
#include "gpio.h"
#include "fmc.h"
#include "app_touchgfx.h"
#include "mbedtls.h"

/* USER CODE BEGIN Includes */
#include "gt911.h"
#include "lcd.h"
#include "at24cxx.h"
#include "string.h"
#include "cm_backtrace.h"
/* USER CODE END Includes */

/* USER CODE BEGIN PD */
#define APPLICATION_ADDRESS ((uint32_t)0x90000000)
/* USER CODE END PD */

/* USER CODE BEGIN PV */
uint32_t g_osRuntimeCounter = 0;        //FreeRTOS运行计数
/* USER CODE END PV */

void SystemClock_Config(void);
//static void MPU_Initialize(void);
static void MPU_Config(void);
void MX_FREERTOS_Init(void);

/* USER CODE BEGIN 0 */
#ifdef __GNUC__
#define PUTCHAR_PROTOTYPE int __io_putchar(int ch)
#else
#define PUTCHAR_PROTOTYPE int fputc(int ch, FILE *f)
#endif

PUTCHAR_PROTOTYPE
{
	HAL_UART_Transmit(&huart4, (uint8_t*)&ch, 1, 0xff);
	return ch;
}
/* USER CODE END 0 */

int main(void)
{
  /* USER CODE BEGIN 1 */

	SCB->VTOR = APPLICATION_ADDRESS;
	__enable_irq();
  /* USER CODE END 1 */

  /* MPU Configuration--------------------------------------------------------*/
  MPU_Config();

  /* Enable I-Cache---------------------------------------------------------*/
  SCB_EnableICache();

  /* Enable D-Cache---------------------------------------------------------*/
  SCB_EnableDCache();

  /* MCU Configuration--------------------------------------------------------*/

  /* Reset of all peripherals, Initializes the Flash interface and the Systick. */
  HAL_Init();

  /* USER CODE BEGIN Init */
//	SCB->CACR|=1<<2;   //强制D-Cache透写,CPU 每次操作 Cache 里面的数据，同时也会更新到 SRAM 里面，不需要再发送clean操作，保证D Cache 和 SRAM 里面数据一致。
  /* USER CODE END Init */

  /* Configure the system clock */
  SystemClock_Config();

  /* USER CODE BEGIN SysInit */
  cm_backtrace_init("BSMU_H750IB", "1.0", "1.0");
  AT24Cxx_Init();					//初始化AT24C02
  //读取AT24C02并更新参数
	AT24Cxx_SeqRead(0x00, CAPACITY_SIZE, eerom_data.ReadBuff);
	memcpy(&bsmuSetting, eerom_data.ReadBuff, sizeof(EEPROM_BSMU));
  /* USER CODE END SysInit */

  /* Initialize all configured peripherals */
  MX_GPIO_Init();
  MX_DMA_Init();
  MX_FDCAN2_Init();
  MX_FMC_Init();
  MX_DMA2D_Init();
  MX_CRC_Init();
  MX_LTDC_Init();
  MX_TIM6_Init();
  MX_SPI2_Init();
  MX_UART5_Init();
  MX_USART2_UART_Init();
  MX_UART4_Init();
  MX_RNG_Init();
  MX_RTC_Init();
  /* Call PreOsInit function */
  MX_MBEDTLS_Init();
  MX_TouchGFX_PreOSInit();
  /* USER CODE BEGIN 2 */
#if TOUCHGFX_ENABLE
  MX_TouchGFX_Init();
  /* Call PreOsInit function */
  MX_TouchGFX_PreOSInit();
	/*程序运行MX_TouchGFX_Init();时，会调用临界保护代码
	taskENTER_CRITICAL()；和	taskEXIT_CRITICAL();
	但是在退出临界保护阶段，并没有重新开启中断，（具体原因待查）。
	*/
  portENABLE_INTERRUPTS();      //重新开启中断
#endif
	Init_printf();                //初始化打印信息
	GT911_init();                 //在此处初始化GT911
	HAL_TIM_Base_Start_IT(&htim6);    //用于FREERTOS任务使用率计数

  /* USER CODE END 2 */

  /* Call init function for freertos objects (in freertos.c) */
  MX_FREERTOS_Init();

  /* Start scheduler */
  osKernelStart();

  /* We should never get here as control is now taken by the scheduler */
  /* Infinite loop */
  while (1)
  {

  }
}

void SystemClock_Config(void)
{
  RCC_OscInitTypeDef RCC_OscInitStruct = {0};
  RCC_ClkInitTypeDef RCC_ClkInitStruct = {0};

  /** Supply configuration update enable
  */
  HAL_PWREx_ConfigSupply(PWR_LDO_SUPPLY);

  /** Configure the main internal regulator output voltage
  */
  __HAL_PWR_VOLTAGESCALING_CONFIG(PWR_REGULATOR_VOLTAGE_SCALE1);

  while(!__HAL_PWR_GET_FLAG(PWR_FLAG_VOSRDY)) {}

  __HAL_RCC_SYSCFG_CLK_ENABLE();
  __HAL_PWR_VOLTAGESCALING_CONFIG(PWR_REGULATOR_VOLTAGE_SCALE0);

  while(!__HAL_PWR_GET_FLAG(PWR_FLAG_VOSRDY)) {}

  /** Initializes the RCC Oscillators according to the specified parameters
  * in the RCC_OscInitTypeDef structure.
  */
  RCC_OscInitStruct.OscillatorType = RCC_OSCILLATORTYPE_LSI|RCC_OSCILLATORTYPE_HSE;
  RCC_OscInitStruct.HSEState = RCC_HSE_ON;
  RCC_OscInitStruct.LSIState = RCC_LSI_ON;
  RCC_OscInitStruct.PLL.PLLState = RCC_PLL_ON;
  RCC_OscInitStruct.PLL.PLLSource = RCC_PLLSOURCE_HSE;
  RCC_OscInitStruct.PLL.PLLM = 5;
  RCC_OscInitStruct.PLL.PLLN = 192;
  RCC_OscInitStruct.PLL.PLLP = 2;
  RCC_OscInitStruct.PLL.PLLQ = 12;
  RCC_OscInitStruct.PLL.PLLR = 2;
  RCC_OscInitStruct.PLL.PLLRGE = RCC_PLL1VCIRANGE_2;
  RCC_OscInitStruct.PLL.PLLVCOSEL = RCC_PLL1VCOWIDE;
  RCC_OscInitStruct.PLL.PLLFRACN = 0;
  if (HAL_RCC_OscConfig(&RCC_OscInitStruct) != HAL_OK)
  {
    Error_Handler();
  }

  /** Initializes the CPU, AHB and APB buses clocks
  */
  RCC_ClkInitStruct.ClockType = RCC_CLOCKTYPE_HCLK|RCC_CLOCKTYPE_SYSCLK
                              |RCC_CLOCKTYPE_PCLK1|RCC_CLOCKTYPE_PCLK2
                              |RCC_CLOCKTYPE_D3PCLK1|RCC_CLOCKTYPE_D1PCLK1;
  RCC_ClkInitStruct.SYSCLKSource = RCC_SYSCLKSOURCE_PLLCLK;
  RCC_ClkInitStruct.SYSCLKDivider = RCC_SYSCLK_DIV1;
  RCC_ClkInitStruct.AHBCLKDivider = RCC_HCLK_DIV2;
  RCC_ClkInitStruct.APB3CLKDivider = RCC_APB3_DIV2;
  RCC_ClkInitStruct.APB1CLKDivider = RCC_APB1_DIV2;
  RCC_ClkInitStruct.APB2CLKDivider = RCC_APB2_DIV2;
  RCC_ClkInitStruct.APB4CLKDivider = RCC_APB4_DIV2;

  if (HAL_RCC_ClockConfig(&RCC_ClkInitStruct, FLASH_LATENCY_4) != HAL_OK)
  {
    Error_Handler();
  }

  /** Enables the Clock Security System
  */
  HAL_RCC_EnableCSS();
}

/* MPU Configuration */

void MPU_Config(void)
{
  MPU_Region_InitTypeDef MPU_InitStruct = {0};

  /* Disables the MPU */
  HAL_MPU_Disable();

  /** Initializes and configures the Region and the memory to be protected
  */
  MPU_InitStruct.Enable = MPU_REGION_ENABLE;
  MPU_InitStruct.Number = MPU_REGION_NUMBER1;
  MPU_InitStruct.BaseAddress = 0x30040000;
  MPU_InitStruct.Size = MPU_REGION_SIZE_32KB;
  MPU_InitStruct.SubRegionDisable = 0x0;
  MPU_InitStruct.TypeExtField = MPU_TEX_LEVEL1;
  MPU_InitStruct.AccessPermission = MPU_REGION_FULL_ACCESS;
  MPU_InitStruct.DisableExec = MPU_INSTRUCTION_ACCESS_DISABLE;
  MPU_InitStruct.IsShareable = MPU_ACCESS_NOT_SHAREABLE;
  MPU_InitStruct.IsCacheable = MPU_ACCESS_NOT_CACHEABLE;
  MPU_InitStruct.IsBufferable = MPU_ACCESS_NOT_BUFFERABLE;

  HAL_MPU_ConfigRegion(&MPU_InitStruct);

  /** Initializes and configures the Region and the memory to be protected
  */
  MPU_InitStruct.Number = MPU_REGION_NUMBER2;
  MPU_InitStruct.Size = MPU_REGION_SIZE_256B;
  MPU_InitStruct.TypeExtField = MPU_TEX_LEVEL0;
  MPU_InitStruct.IsShareable = MPU_ACCESS_SHAREABLE;
  MPU_InitStruct.IsBufferable = MPU_ACCESS_BUFFERABLE;

  HAL_MPU_ConfigRegion(&MPU_InitStruct);

  /** Initializes and configures the Region and the memory to be protected
  */
  MPU_InitStruct.Number = MPU_REGION_NUMBER3;
  MPU_InitStruct.BaseAddress = 0x30020000;
  MPU_InitStruct.Size = MPU_REGION_SIZE_32KB;
  MPU_InitStruct.TypeExtField = MPU_TEX_LEVEL1;
  MPU_InitStruct.IsShareable = MPU_ACCESS_NOT_SHAREABLE;
  MPU_InitStruct.IsBufferable = MPU_ACCESS_NOT_BUFFERABLE;

  HAL_MPU_ConfigRegion(&MPU_InitStruct);

  /** Initializes and configures the Region and the memory to be protected
  */
  MPU_InitStruct.Number = MPU_REGION_NUMBER4;
  MPU_InitStruct.BaseAddress = 0xC0000000;
  MPU_InitStruct.Size = MPU_REGION_SIZE_4MB;

  HAL_MPU_ConfigRegion(&MPU_InitStruct);

  /**
   * Region 5专门覆盖UART5、UART4和USART2的DMA缓冲区地址槽。
   *
   * 三个Uart_BUFF在当前Keil链接映射中的固定地址分别为：
   *   UART5  ：0x30000000～0x30000C03；
   *   UART4  ：0x30001000～0x30001C03；
   *   USART2 ：0x30002000～0x30002C03。
   *
   * 每个对象独占一个4 KB地址槽，因此需要设置为不可缓存的完整范围是
   * 0x30000000～0x30002FFF。这里先建立一个16 KB MPU Region，再通过
   * SubRegionDisable=0xC0关闭最后两个2 KB子区，确保0x30003000～
   * 0x30003FFF以及后续D2 SRAM仍保持原有内存属性。
   *
   * 该区域配置为Normal、Shareable、Non-cacheable、Non-bufferable，
   * 使CPU和DMA直接访问同一份SRAM数据，避免D-Cache产生旧帧或CRC异常。
   */
  MPU_InitStruct.Enable = MPU_REGION_ENABLE;
  MPU_InitStruct.Number = MPU_REGION_NUMBER5;
  MPU_InitStruct.BaseAddress = 0x30000000;
  MPU_InitStruct.Size = MPU_REGION_SIZE_16KB;
  MPU_InitStruct.SubRegionDisable = 0xC0;
  MPU_InitStruct.TypeExtField = MPU_TEX_LEVEL1;
  MPU_InitStruct.AccessPermission = MPU_REGION_FULL_ACCESS;
  MPU_InitStruct.DisableExec = MPU_INSTRUCTION_ACCESS_DISABLE;
  MPU_InitStruct.IsShareable = MPU_ACCESS_SHAREABLE;
  MPU_InitStruct.IsCacheable = MPU_ACCESS_NOT_CACHEABLE;
  MPU_InitStruct.IsBufferable = MPU_ACCESS_NOT_BUFFERABLE;

  HAL_MPU_ConfigRegion(&MPU_InitStruct);

  /* Enables the MPU */
  HAL_MPU_Enable(MPU_PRIVILEGED_DEFAULT);

}

void HAL_TIM_PeriodElapsedCallback(TIM_HandleTypeDef *htim)
{
  if (htim->Instance == TIM7) {
    HAL_IncTick();
  }
  /* USER CODE BEGIN Callback 1 */
  if (htim->Instance == TIM6) {
		g_osRuntimeCounter ++;
  }
  /* USER CODE END Callback 1 */
}

void Error_Handler(void)
{
  __disable_irq();
  while (1)
  {
  }
}

#ifdef  USE_FULL_ASSERT
/**
  * @brief  Reports the name of the source file and the source line number
  *         where the assert_param error has occurred.
  * @param  file: pointer to the source file name
  * @param  line: assert_param error line source number
  * @retval None
  */
void assert_failed(uint8_t *file, uint32_t line)
{
  /* USER CODE BEGIN 6 */
  /* User can add his own implementation to report the file name and line number,
     ex: Debug_printf("Wrong parameters value: file %s on line %d\r\n", file, line) */
  /* USER CODE END 6 */
}
#endif /* USE_FULL_ASSERT */

// file: Core/Src/freertos.c
/* USER CODE BEGIN Header */
/**
 ******************************************************************************
 * File Name          : freertos.c
 * Description        : Code for freertos applications
 ******************************************************************************
 * @attention
 *
 * Copyright (c) 2022 STMicroelectronics.
 * All rights reserved.
 *
 * This software is licensed under terms that can be found in the LICENSE file
 * in the root directory of this software component.
 * If no LICENSE file comes with this software, it is provided AS-IS.
 *
 ******************************************************************************
 */
/* USER CODE END Header */

#include "FreeRTOS.h"
#include "task.h"
#include "main.h"
#include "cmsis_os.h"

/* USER CODE BEGIN Includes */
#include "AT_module_4g.h"
#include "CAN_Control.h"
#include "RS485.h"
#include "modbus_slave.h"
#include "modbus.h"
#include "client.h"
#include "fdcan.h"
#include "gt911.h"
#include "http_client.h"
#include "lcd.h"
#include "sntp_client.h"
#include "station_ctl.h"
#include "stdint.h"
#include "usart.h"
#include "at24cxx.h"
#include "data_persistence.h"
#include "screen_sleep.h"
#include "EMS_strategy.h"
#include <stdio.h>
#include <stdlib.h>
#include <string.h>
/* USER CODE END Includes */

/* USER CODE BEGIN Variables */
extern TIM_HandleTypeDef htim6;
extern osThreadId Client_threadHandle;
//osThreadId TCP_Send_threadHandle;
extern osThreadId TCP_Recv_threadHandle;
extern osMessageQId CANQueueHandle[cluster_num];
extern osThreadId CAN_Rev_TaskHandle;
extern osThreadId CAN_Poll_TaskHandle;
extern osSemaphoreId ETHSndSemHandle;
extern osThreadId httpc_handle;
extern osThreadId modbus_taskhandle;

osThreadId CPU_Task_ThreadHandle;
/* USER CODE END Variables */
osThreadId startup_ThreadHandle;
osThreadId TouchGFXHandle;
osMutexId DebugUartMutexHandle;

/* USER CODE BEGIN FunctionPrototypes */
void TaskTcbPrintf(void);
void CPU_Task (void const *argument);
/* USER CODE END FunctionPrototypes */

void Startup(void const * argument);
void TouchGFX_Task(void const * argument);

void MX_FREERTOS_Init(void); /* (MISRA C 2004 rule 8.1) */

/* GetIdleTaskMemory prototype (linked to static allocation support) */
void vApplicationGetIdleTaskMemory( StaticTask_t **ppxIdleTaskTCBBuffer, StackType_t **ppxIdleTaskStackBuffer, uint32_t *pulIdleTaskStackSize );

/* GetTimerTaskMemory prototype (linked to static allocation support) */
void vApplicationGetTimerTaskMemory( StaticTask_t **ppxTimerTaskTCBBuffer, StackType_t **ppxTimerTaskStackBuffer, uint32_t *pulTimerTaskStackSize );

/* Hook prototypes */
void configureTimerForRunTimeStats(void);
unsigned long getRunTimeCounterValue(void);

/* USER CODE BEGIN 1 */
/* Functions needed when configGENERATE_RUN_TIME_STATS is on */
extern uint32_t g_osRuntimeCounter;
__weak void
configureTimerForRunTimeStats (void)
{
  g_osRuntimeCounter = 0;
}

__weak unsigned long
getRunTimeCounterValue (void)
{
  return g_osRuntimeCounter;
}
/* USER CODE END 1 */

/* USER CODE BEGIN GET_IDLE_TASK_MEMORY */
static StaticTask_t xIdleTaskTCBBuffer;
static StackType_t xIdleStack[configMINIMAL_STACK_SIZE];

void
vApplicationGetIdleTaskMemory (StaticTask_t **ppxIdleTaskTCBBuffer,
                               StackType_t **ppxIdleTaskStackBuffer,
                               uint32_t *pulIdleTaskStackSize)
{
  *ppxIdleTaskTCBBuffer = &xIdleTaskTCBBuffer;
  *ppxIdleTaskStackBuffer = &xIdleStack[0];
  *pulIdleTaskStackSize = configMINIMAL_STACK_SIZE;
  /* place for user code */
}
/* USER CODE END GET_IDLE_TASK_MEMORY */

/* USER CODE BEGIN GET_TIMER_TASK_MEMORY */
static StaticTask_t xTimerTaskTCBBuffer;
static StackType_t xTimerStack[configTIMER_TASK_STACK_DEPTH];

void
vApplicationGetTimerTaskMemory (StaticTask_t **ppxTimerTaskTCBBuffer,
                                StackType_t **ppxTimerTaskStackBuffer,
                                uint32_t *pulTimerTaskStackSize)
{
  *ppxTimerTaskTCBBuffer = &xTimerTaskTCBBuffer;
  *ppxTimerTaskStackBuffer = &xTimerStack[0];
  *pulTimerTaskStackSize = configTIMER_TASK_STACK_DEPTH;
  /* place for user code */
}
/* USER CODE END GET_TIMER_TASK_MEMORY */

void MX_FREERTOS_Init(void) {
  /* Create the mutex(es) */
  /* definition and creation of DebugUartMutex */
  osMutexDef(DebugUartMutex);
  DebugUartMutexHandle = osMutexCreate(osMutex(DebugUartMutex));

  /* Create the thread(s) */
  /* definition and creation of startup_Thread */
  osThreadDef(startup_Thread, Startup, osPriorityRealtime, 0, 256);
  startup_ThreadHandle = osThreadCreate(osThread(startup_Thread), NULL);

  /* definition and creation of TouchGFX */
  osThreadDef(TouchGFX, TouchGFX_Task, osPriorityBelowNormal, 0, 3072);
  TouchGFXHandle = osThreadCreate(osThread(TouchGFX), NULL);

}

void Startup(void const * argument)
{
  /* USER CODE BEGIN Startup */
  StationDataInit();
  flash_save_init();
  mbedtls_net_init (NULL);
  sntp_client_init ();
  // 开启CAN接收线程
  BSMU_CANInit ();
  // 开启4G模块线程
  Module4G_Init ();

  screen_sleep_init();
  modbus_init ();

  if (bsmuSetting.local_flag){
  // 开启客户端线程
    ClientInit ();
  }

  if (bsmuSetting.yunduan_flag){
    http_client_init ();
  }

  TaskTcbPrintf();
  // 开启CPU_Task线程
  osThreadDef (CPU_Task_Thread, CPU_Task, osPriorityIdle, 0, 256);
  CPU_Task_ThreadHandle = osThreadCreate (osThread (CPU_Task_Thread), NULL);
#if TOUCHGFX_ENABLE
  vTaskDelay (200); // 延迟200ms再开启背光
  LCD_BL (1);       // 开启背光
#endif
  vTaskDelete (startup_ThreadHandle); // 删除该任务
  /* Infinite loop */
  for (;;)
    {
      osDelay (1);
    }
  /* USER CODE END Startup */
}

__weak void TouchGFX_Task(void const * argument)
{
  /* USER CODE BEGIN TouchGFX_Task */
  /* Infinite loop */
  for (;;)
    {
      osDelay (1);
    }
  /* USER CODE END TouchGFX_Task */
}

/* USER CODE BEGIN Application */
/* USER CODE BEGIN Header_CPU_Task */
/**
 * @brief Function implementing the CPU_Task_Thread thread.
 * @param argument: Not used
 * @retval None
 */
/* USER CODE END Header_CPU_Task */
void
CPU_Task (void const *argument)
{
  /* USER CODE BEGIN CPU_Task */
  /* Infinite loop */
  for (;;)
    {
#if CPU_PRINTF
      char *pbuffer = (char *)malloc(300* sizeof (char));
      vTaskList (pbuffer);
      Debug_printf ("----------------------------------------------\r\n");
      Debug_printf ("Task_name         state    priority     remaining_stack  "
                    "Task_Num\r\n");
      Debug_printf ("%s", pbuffer);
      memset (pbuffer, 0, sizeof (char) * 200);
      Debug_printf ("----------------------------------------------\r\n");
      Debug_printf ("Task_name   Running count                 usage\r\n");
      vTaskGetRunTimeStats (pbuffer);
      Debug_printf ("%s", pbuffer);
      free(pbuffer);
      Debug_printf ("----------------------------------------------\r\n");
      Debug_printf ("FreeHeapSize:%d\n", xPortGetFreeHeapSize ());
      Debug_printf ("MiniFreeHeapSize:%d\n",
                    xPortGetMinimumEverFreeHeapSize ());
      Debug_printf ("CPU_Task_minStack:%d\n",
                    (int)uxTaskGetStackHighWaterMark (CPU_Task_ThreadHandle));
      Debug_printf ("GFX_Task_minStack:%d\n",
                    (int)uxTaskGetStackHighWaterMark (TouchGFXHandle));
      Debug_printf ("Client_Task_minStack:%d\n",
                    (int)uxTaskGetStackHighWaterMark (Client_threadHandle));
      Debug_printf ("TCP_Rev_Task_minStack:%d\n",
                    (int)uxTaskGetStackHighWaterMark (TCP_Recv_threadHandle));
      Debug_printf ("CAN_Rev_Thread_minStack:%d\n",
                    (int)uxTaskGetStackHighWaterMark (CAN_Rev_TaskHandle));
      Debug_printf ("CAN_Poll_Thread_minStack:%d\n",
                    (int)uxTaskGetStackHighWaterMark (CAN_Poll_TaskHandle));
      Debug_printf ("Module4G_Process_minStack:%d\n",
                    (int)uxTaskGetStackHighWaterMark (Module4G_TaskHandle));
      Debug_printf ("modbus_Process_minStack:%d\n",
                    (int)uxTaskGetStackHighWaterMark (modbus_taskhandle));
      Debug_printf ("https_Process_minStack:%d\n",
                    (int)uxTaskGetStackHighWaterMark (httpc_handle));
      Debug_printf ("----------------------------------------------\r\n");
      Debug_printf (
          "Queue_name      QueueMessagesWaiting   QueueSpacesAvailable\r\n");
      for (uint8_t i = 0; i < cluster_num; i++)
        Debug_printf ("CANQueue%d       %d                       %d\n", i + 1,
                      (int)uxQueueMessagesWaiting (CANQueueHandle[i]),
                      (int)uxQueueSpacesAvailable (CANQueueHandle[i]));

        // 测试485
//	RS485_REV();
#endif
      HAL_GPIO_TogglePin (LED_G_GPIO_Port, LED_G_Pin);
      modelToViewData.frameRate = modelToViewData.frameRateCount;
      modelToViewData.frameRateCount = 0;
      vTaskDelay (1000);
    }
  //    osDelay(1);
  /* USER CODE END CPU_Task */
}
/* USER CODE END Application */
